/**
 * @cliArgs --device "F2837xD" --part "F2837xD_100PTP" --package "F2837xD_100PTP" --context "CPU1" --product "C2000WARE@6.00.00.00"
 * @versions {"tool":"1.25.0+4268"}
 */

/**
 * Import the modules used in this configuration.
 */
const spi  = scripting.addModule("/driverlib/spi.js", {}, false);
const spi1 = spi.addInstance();

/**
 * Write custom configuration values to the imported modules.
 */
spi1.$name          = "mySPI0";
spi1.picoQual.$name = "myGPIOQUAL0";
spi1.pociQual.$name = "myGPIOQUAL1";
spi1.clkQual.$name  = "myGPIOQUAL2";
spi1.pteQual.$name  = "myGPIOQUAL3";

/**
 * Pinmux solution for unlocked pins/peripherals. This ensures that minor changes to the automatic solver in a future
 * version of the tool will not impact the pinmux you originally saw.  These lines can be completely deleted in order to
 * re-solve from scratch.
 */
spi1.spi.$suggestSolution             = "SPIB";
spi1.spi.spi_picoPin.$suggestSolution = "GPIO60";
spi1.spi.spi_pociPin.$suggestSolution = "GPIO61";
spi1.spi.spi_clkPin.$suggestSolution  = "GPIO58";
spi1.spi.spi_ptePin.$suggestSolution  = "GPIO59";
